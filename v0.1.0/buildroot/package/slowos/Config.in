## v0.1.0/buildroot/package/slowos/Config.in
```kconfig
config BR2_PACKAGE_SLOWOS
	bool "slowos"
	help
	  SlowOS - A minimal operating system for the Slow Computer.
	  System 6-inspired desktop environment with focused applications.

	  https://slowcomputer.co
```

## v0.2.0/buildroot/configs/slowos_defconfig
```kconfig
# SlowOS Buildroot Configuration
# Target: Raspberry Pi Zero 2 W
#
# Usage:
#   make BR2_EXTERNAL=../buildroot slowos_defconfig
#   make
#

# Architecture: ARM 64-bit (Pi Zero 2 W is BCM2710 / Cortex-A53)
BR2_aarch64=y
BR2_cortex_a53=y

# Toolchain
BR2_TOOLCHAIN_BUILDROOT_GLIBC=y
BR2_TOOLCHAIN_BUILDROOT_CXX=y

# System
BR2_TARGET_GENERIC_HOSTNAME="slowbook"
BR2_TARGET_GENERIC_ISSUE="Welcome to SlowOS"
BR2_TARGET_GENERIC_GETTY_PORT="tty1"
BR2_TARGET_GENERIC_GETTY_BAUDRATE_115200=y
BR2_SYSTEM_DHCP="wlan0"

# Root filesystem
BR2_TARGET_GENERIC_ROOT_PASSWD=""
BR2_TARGET_ROOTFS_EXT2=y
BR2_TARGET_ROOTFS_EXT2_4=y
BR2_TARGET_ROOTFS_EXT2_SIZE="512M"

# Kernel
BR2_LINUX_KERNEL=y
BR2_LINUX_KERNEL_CUSTOM_TARBALL=y
BR2_LINUX_KERNEL_DEFCONFIG="bcm2711"
BR2_LINUX_KERNEL_DTS_SUPPORT=y
BR2_LINUX_KERNEL_INTREE_DTS_NAME="broadcom/bcm2710-rpi-zero-2-w"

# Bootloader
BR2_PACKAGE_RPI_FIRMWARE=y
BR2_PACKAGE_RPI_FIRMWARE_VARIANT_PI=y

# Firmware for WiFi (BCM43436s on Pi Zero 2 W)
BR2_PACKAGE_LINUX_FIRMWARE=y
BR2_PACKAGE_LINUX_FIRMWARE_BRCM_BCM43XX=y

# Display — Wayland + cage (single-app kiosk compositor)
# cage runs exactly one app fullscreen with no window decorations.
# Much lighter than X11 for a single-application embedded system.
BR2_PACKAGE_WESTON=y
BR2_PACKAGE_CAGE=y
BR2_PACKAGE_MESA3D=y
BR2_PACKAGE_MESA3D_DRI_DRIVER_V3D=y
BR2_PACKAGE_MESA3D_GALLIUM_DRIVER_VC4=y
BR2_PACKAGE_MESA3D_OPENGL_EGL=y
BR2_PACKAGE_MESA3D_OPENGL_ES=y
BR2_PACKAGE_LIBDRM=y
BR2_PACKAGE_LIBINPUT=y
BR2_PACKAGE_EUDEV=y
BR2_PACKAGE_WAYLAND=y
BR2_PACKAGE_WAYLAND_PROTOCOLS=y

# Fallback: X11 with fbdev for e-ink panels that need framebuffer
BR2_PACKAGE_XORG7=y
BR2_PACKAGE_XSERVER_XORG_SERVER=y
BR2_PACKAGE_XDRIVER_XF86_VIDEO_FBDEV=y
BR2_PACKAGE_XDRIVER_XF86_INPUT_EVDEV=y
BR2_PACKAGE_XDRIVER_XF86_INPUT_KEYBOARD=y
BR2_PACKAGE_XDRIVER_XF86_INPUT_MOUSE=y
BR2_PACKAGE_XAPP_XINIT=y
BR2_PACKAGE_XLIB_LIBXRANDR=y
BR2_PACKAGE_XLIB_LIBXCURSOR=y

# Audio (for slowMusic)
BR2_PACKAGE_ALSA_UTILS=y
BR2_PACKAGE_ALSA_LIB=y

# Networking
BR2_PACKAGE_WPA_SUPPLICANT=y
BR2_PACKAGE_WPA_SUPPLICANT_NL80211=y
BR2_PACKAGE_DHCPCD=y

# Core utilities
BR2_PACKAGE_BUSYBOX=y
BR2_PACKAGE_BASH=y

# Filesystem tools
BR2_PACKAGE_E2FSPROGS=y

# SlowOS package
BR2_PACKAGE_SLOWOS=y

# Root filesystem overlay
BR2_ROOTFS_OVERLAY="$(BR2_EXTERNAL_SLOWOS_PATH)/rootfs_overlay"

# Post-build scripts
BR2_ROOTFS_POST_BUILD_SCRIPT="$(BR2_EXTERNAL_SLOWOS_PATH)/board/slowcomputer/post-build.sh"
BR2_ROOTFS_POST_IMAGE_SCRIPT="$(BR2_EXTERNAL_SLOWOS_PATH)/board/slowcomputer/post-image.sh"

# SD card image generation
BR2_PACKAGE_HOST_DOSFSTOOLS=y
BR2_PACKAGE_HOST_GENIMAGE=y
BR2_PACKAGE_HOST_MTOOLS=y
```
