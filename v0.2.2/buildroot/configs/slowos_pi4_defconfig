## v0.2.2/buildroot/configs/slowos_pi4_defconfig
```kconfig
# SlowOS Pi 4 HDMI Configuration
# Target: Raspberry Pi 4 Model B (HDMI with Mesa swrast)
#
# Usage:
#   make BR2_EXTERNAL=../buildroot slowos_pi4_defconfig
#   make
#

# Architecture: ARM 64-bit
BR2_aarch64=y
BR2_cortex_a72=y

# Toolchain
BR2_TOOLCHAIN_BUILDROOT_GLIBC=y
BR2_TOOLCHAIN_BUILDROOT_CXX=y
BR2_PACKAGE_HOST_RUSTC=y
BR2_PACKAGE_HOST_RUST_BIN=y

# System
BR2_TARGET_GENERIC_HOSTNAME="slowbook"
BR2_TARGET_GENERIC_ISSUE="Welcome to SlowOS"
BR2_TARGET_GENERIC_GETTY_PORT="tty1"
BR2_TARGET_GENERIC_GETTY_BAUDRATE_115200=y
BR2_SYSTEM_DHCP="wlan0,eth0"

# Root filesystem
BR2_TARGET_GENERIC_ROOT_PASSWD="0917"
BR2_TARGET_ROOTFS_EXT2=y
BR2_TARGET_ROOTFS_EXT2_4=y
BR2_TARGET_ROOTFS_EXT2_SIZE="512M"

# Kernel
BR2_LINUX_KERNEL=y
BR2_LINUX_KERNEL_DTS_SUPPORT=y
BR2_LINUX_KERNEL_INTREE_DTS_NAME="broadcom/bcm2711-rpi-4-b"

# Bootloader
BR2_PACKAGE_RPI_FIRMWARE=y
BR2_PACKAGE_RPI_FIRMWARE_VARIANT_PI4=y

# Firmware for WiFi
BR2_PACKAGE_LINUX_FIRMWARE=y
BR2_PACKAGE_LINUX_FIRMWARE_BRCM43XX=y

# HDMI Display Stack (Xorg modesetting + KMS: Pi4 VC4/V3D Gallium + swrast fallback)
BR2_PACKAGE_MESA3D=y
BR2_PACKAGE_MESA3D_GALLIUM_DRIVER_SWRAST=y
BR2_PACKAGE_MESA3D_DRI_DRIVER_V3D=y
BR2_PACKAGE_MESA3D_GALLIUM_DRIVER_VC4=y
BR2_PACKAGE_MESA3D_OPENGL_EGL=y
BR2_PACKAGE_MESA3D_OPENGL_ES=y
BR2_PACKAGE_MESA3D_OPENGL_GLX=y
BR2_PACKAGE_MESA3D_GBM=y
BR2_PACKAGE_MESA3D_NEEDS_X11=y
BR2_PACKAGE_MESA3D_DEMOS=y
BR2_PACKAGE_LIBDRM=y

# Xorg for HDMI
BR2_PACKAGE_XORG7=y
BR2_PACKAGE_XSERVER_XORG_SERVER=y
BR2_PACKAGE_XDRIVER_XF86_VIDEO_FBDEV=y
BR2_PACKAGE_XDRIVER_XF86_VIDEO_MODESETTING=y
BR2_PACKAGE_XDRIVER_XF86_INPUT_EVDEV=y
BR2_PACKAGE_XDRIVER_XF86_INPUT_MOUSE=y
BR2_PACKAGE_XAPP_XINIT=y
BR2_PACKAGE_XAPP_XINPUT=y
BR2_PACKAGE_XAPP_XEV=y
BR2_PACKAGE_LIBINPUT=y
BR2_PACKAGE_XAPP_XSET=y
BR2_PACKAGE_XAPP_XDPYINFO=y
BR2_PACKAGE_XAPP_XPROP=y
BR2_PACKAGE_XAPP_XWININFO=y
BR2_PACKAGE_XAPP_XRANDR=y
BR2_PACKAGE_XLIB_LIBXRANDR=y
BR2_PACKAGE_XLIB_LIBXCURSOR=y
BR2_PACKAGE_WMCTRL=y
BR2_PACKAGE_XDOTOOL=y
BR2_PACKAGE_EVTEST=y

# X11 support libraries
BR2_PACKAGE_LIBXKBCOMMON=y
BR2_PACKAGE_LIBXKBCOMMON_X11=y

# Audio (for slowMusic)
BR2_PACKAGE_ALSA_UTILS=y
BR2_PACKAGE_ALSA_LIB=y

# Networking
BR2_PACKAGE_WPA_SUPPLICANT=y
BR2_PACKAGE_WPA_SUPPLICANT_NL80211=y
BR2_PACKAGE_DHCPCD=y

# SSH Access (unset SMALL: Buildroot default is y; full Dropbear improves pubkey interoperability)
BR2_PACKAGE_DROPBEAR=y
BR2_PACKAGE_DROPBEAR_SERVER=y
BR2_PACKAGE_DROPBEAR_KEYGEN=y
# BR2_PACKAGE_DROPBEAR_SMALL is not set

# Core utilities
BR2_PACKAGE_BUSYBOX=y
BR2_PACKAGE_BASH=y

# Filesystem tools
BR2_PACKAGE_E2FSPROGS=y

# SlowOS package
BR2_PACKAGE_SLOWOS=y

# E-ink bridge dependencies (keep minimal for compatibility)
BR2_PACKAGE_PYTHON3=y
BR2_PACKAGE_PYTHON_PILLOW=y
BR2_PACKAGE_PYTHON_SPIDEV=y
BR2_PACKAGE_PYTHON_GPIOZERO=y
BR2_PACKAGE_XAPP_XWD=y
BR2_PACKAGE_IMAGEMAGICK=y

# Root filesystem overlay for Pi 4
BR2_ROOTFS_OVERLAY="$(BR2_EXTERNAL_SLOWOS_PATH)/rootfs_overlay"

# Post-build scripts
BR2_ROOTFS_POST_BUILD_SCRIPT="$(BR2_EXTERNAL_SLOWOS_PATH)/board/slowcomputer/post-build.sh"
BR2_ROOTFS_POST_IMAGE_SCRIPT="$(BR2_EXTERNAL_SLOWOS_PATH)/board/slowcomputer/post-image.sh"

# SD card image generation
BR2_PACKAGE_HOST_DOSFSTOOLS=y
BR2_PACKAGE_HOST_GENIMAGE=y
BR2_PACKAGE_HOST_MTOOLS=y
BR2_ROOTFS_DEVICE_CREATION_DYNAMIC_EUDEV=y

# Kernel config fragments
BR2_LINUX_KERNEL_CONFIG_FRAGMENT_FILES="$(BR2_EXTERNAL_SLOWOS_PATH)/board/slowcomputer/kernel-configs/fragments.config"
BR2_LINUX_KERNEL_USE_CUSTOM_CONFIG=y
BR2_LINUX_KERNEL_CUSTOM_CONFIG_FILE="$(BR2_EXTERNAL_SLOWOS_PATH)/board/slowcomputer/kernel-configs/linux.config"

# Locale support
BR2_ENABLE_LOCALE=y
BR2_LOCALES="en_US.UTF-8 C"
BR2_ENABLE_LOCALE_PURGE=n
BR2_GENERATE_LOCALE="en_US.UTF-8 C"

# Common GPIO/Raspberry Pi utilities
BR2_PACKAGE_PYTHON_RPI_GPIO=y
BR2_PACKAGE_PYTHON_COLORZERO=y
BR2_PACKAGE_PYTHON_SETUPTOOLS=y
```
